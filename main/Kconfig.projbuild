## main/Kconfig.projbuild
```kconfig
menu "TOTP Configuration"

config TOTP_WIFI_SSID
    string "WiFi SSID"
    default ""
    help
        SSID untuk koneksi WiFi.

config TOTP_WIFI_PASSWORD
    string "WiFi Password"
    default ""
    help
        Password WiFi (boleh kosong untuk open network).

config TOTP_SNTP_SERVER
    string "SNTP Server (Primary)"
    default "pool.ntp.org"
    help
        Server NTP/SNTP utama untuk sinkronisasi waktu.

config TOTP_SNTP_SERVER_BACKUP
    string "SNTP Server (Backup, opsional)"
    default "time.nist.gov"
    help
        Server NTP backup kalau primary timeout.
        Kosongkan untuk disable fallback.

config TOTP_SNTP_TIMEOUT_SEC
    int "SNTP Sync Timeout (seconds)"
    default 60
    range 10 300
    help
        Berapa lama menunggu SNTP sync sebelum timeout.
        Naikin jika network lambat.

config TOTP_SECRET_BASE32
    string "TOTP Secret (Base32)"
    default ""
    help
        Shared secret TOTP dalam format Base32 (contoh: JBSWY3DPEHPK3PXP).
        Huruf besar/kecil tidak berpengaruh. Spasi akan diabaikan.

config TOTP_DIGITS
    int "Digits"
    range 6 8
    default 6
    help
        Jumlah digit kode TOTP (umumnya 6).

config TOTP_TIME_STEP
    int "Time step (seconds)"
    range 10 120
    default 30
    help
        Interval TOTP dalam detik (umumnya 30).

config TOTP_T0
    int "T0 (Unix epoch offset)"
    default 0
    help
        Offset awal (umumnya 0 sesuai RFC6238).

endmenu
```
